#include "wldtool_lookuptable.h"
#include <driver_ili9341.h>
#include <stdint.h>
#include <wldtool_lcd_framework.h>
// ========================== Describe ================================
// saved in 25w0121
// ========================== Describe ================================

unsigned char wldutil_ascill[95][16];
// ========================== Configure ================================
void wldlcd_init() { lcd_ili9341_init(); }
void wldlcd_draw_point(uint16_t location_x, uint16_t location_y,
                       uint32_t color) {
  lcd_ili9341_drawpoint(location_x, location_y, color);
}
void wldlcd_clearscreen(uint32_t color) { lcd_ili9341_fullscreencolor(color); }
void wldlcd_draw_block(uint16_t location_x_start, uint16_t location_y_start,
                       uint16_t location_x_end, uint16_t location_y_end,
                       uint32_t color) {
  lcd_ili9341_drawblock(location_x_start, location_y_start, location_x_end,
                        location_y_end, color);
}
void wldlcd_draw_image(uint16_t location_x, uint16_t location_y,
                       uint16_t image_width, uint16_t image_height,
                       uint8_t *img) {
  lcd_ili9341_drawimage(location_x, location_y, image_width, image_height, img);
}
// ========================== Configure ================================
//
// ========================== NC ================================
uint8_t wldlcd_buffer[__WLDLCD_BUFFER_SIZE];
// ##########################
// ##########################
//
// draw border inside
//
// ##########################
// ##########################
void wldlcd_draw_soildBorder(uint16_t x_start, uint16_t y_start, uint16_t x_end,
                             uint16_t y_end, uint16_t width, uint32_t color) {
  width--; // don't edit
  wldlcd_draw_block(x_start, y_start, x_end, y_start + width, color);
  wldlcd_draw_block(x_start, y_start + width, x_start + width, y_end, color);
  wldlcd_draw_block(x_end - width, y_start + width, x_end, y_end, color);
  wldlcd_draw_block(x_start + width, y_end - width, x_end - width, y_end,
                    color);
}
// ##########################
// ##########################
//
// unefficiency render line method
// wait 2 improve
// ##########################
// ##########################
void wldlcd_draw_line_method_1(uint16_t x_start, uint16_t y_start,
                               uint16_t length, int16_t angle, uint32_t color,
                               uint16_t width) {

  uint16_t render_process = 0;
  float x_vector = 0, y_vector = 0;
  while (angle < 0)
    angle += 360;
  ;
  while (angle > 360)
    angle -= 360;
  ;
  if (angle <= 90) {
    x_vector = wldtool_cos_lookuptable[angle];
    y_vector = wldtool_sin_lookuptable[angle];
  } else if (angle <= 180 & angle > 90) {
    x_vector = -wldtool_cos_lookuptable[180 - angle];
    y_vector = wldtool_sin_lookuptable[180 - angle];

  } else if (angle <= 270 & angle > 180) {
    x_vector = -wldtool_cos_lookuptable[angle - 180];
    y_vector = -wldtool_sin_lookuptable[angle - 180];

  } else {
    x_vector = wldtool_cos_lookuptable[360 - angle];
    y_vector = -wldtool_sin_lookuptable[360 - angle];
  }
  int x_start_render = x_start;
  int y_start_render = y_start;
  int width_render = width;
  for (width_render = 0; width_render < width; width_render++) {
    if (width - 1) {
      if (angle <= 90) {
        x_start_render =
            x_start - (int)((width / 2.0 - (width_render)) * y_vector);
        y_start_render =
            y_start + (int)((width / 2.0 - (width_render)) * x_vector);
      } else if (angle <= 180 & angle > 90) {
        x_start_render =
            x_start + (int)((width / 2.0 - (width_render)) * y_vector);
        y_start_render =
            y_start - (int)((width / 2.0 - (width_render)) * x_vector);

      } else if (angle <= 270 & angle > 180) {
        x_start_render =
            x_start + (int)((width / 2.0 - (width_render)) * y_vector);
        y_start_render =
            y_start - (int)((width / 2.0 - (width_render)) * x_vector);

      } else {
        x_start_render =
            x_start + (int)((width / 2.0 - (width_render)) * y_vector);
        y_start_render =
            y_start - (int)((width / 2.0 - (width_render)) * x_vector);
      }
    }
    for (render_process = 0; render_process <= length; render_process++) {
      wldlcd_draw_point(x_start_render + render_process * x_vector,
                        y_start_render + render_process * y_vector, color);
    }
  }
}
// ##########################
// ##########################
//
// unefficiency render line method
// wait 2 improve
// ##########################
// ##########################
void wldlcd_draw_line_method_2(uint16_t x_start, uint16_t y_start,
                               uint16_t length, uint16_t width, uint16_t angle,
                               uint32_t color) {
  float x_vector, y_vector;
  if (angle <= 90) {
    x_vector = wldtool_cos_lookuptable[angle];
    y_vector = wldtool_sin_lookuptable[angle];
  } else {
    x_vector = wldtool_cos_lookuptable[180 - angle];
    y_vector = wldtool_sin_lookuptable[180 - angle];
  }
  uint16_t x_length = 0, y_length = 0;
  uint16_t x_width = 0, y_width = 0;
  uint16_t render_process = 0;
  x_width = width * y_vector;
  y_width = width * x_vector;
  x_length = length * x_vector;
  y_length = length * y_vector;
  if (angle <= 90) {
    if ((x_length + x_width) >= (y_length + y_width)) {
      // ========================== Configure ================================
      for (render_process = y_start - y_width;
           render_process <= y_start + y_length + y_width; render_process++) {
        if (render_process <= y_start + y_width) {
          wldlcd_draw_block(
              x_start - (render_process - y_start) / x_vector * y_vector,
              render_process,
              x_start + x_width +
                  (render_process - y_start) / y_vector * x_vector,
              render_process, color);

        } else if (render_process >= y_start + y_length) {
          wldlcd_draw_block(
              x_start - x_width +
                  (render_process - y_start - y_width) / y_vector * x_vector,
              render_process,
              x_start + x_length -
                  (render_process - y_start - y_length) / x_vector * y_vector,
              render_process, color);

        } else {
          wldlcd_draw_block(
              x_start - x_width +
                  (render_process - y_start - y_width) / y_vector * x_vector,
              render_process,
              x_start + x_width +
                  (render_process - y_start) / y_vector * x_vector,
              render_process, color);
        }
      }

    } else {
      // ========================== Configure ================================
      for (render_process = x_start - x_width;
           render_process <= x_start + x_length; render_process++) {
        if (render_process <= x_start) {
          wldlcd_draw_block(
              render_process,
              y_start + y_width -
                  (render_process - x_start + x_width) / y_vector * x_vector,
              render_process,
              y_start + y_width +
                  (render_process - x_start + x_width) / x_vector * y_vector,
              color);

        } else if (render_process >= x_start + x_length - x_width) {
          wldlcd_draw_block(
              render_process,
              y_start + (render_process - x_start) / x_vector * y_vector,
              render_process,
              y_start + y_width + y_length -
                  (render_process - x_start - x_length + x_width) / y_vector *
                      x_vector,
              color);

        } else {
          wldlcd_draw_block(
              render_process,
              y_start + (render_process - x_start) / x_vector * y_vector,
              render_process,
              y_start + y_width +
                  (render_process - x_start + x_width) / x_vector * y_vector,
              color);
        }
      }
    }
  } else {
    // ========================== Configure ================================
    if ((x_length + x_width) >= (y_length + y_width)) {
      for (render_process = y_start - y_width;
           render_process <= y_start + y_length + y_width; render_process++) {
        if (render_process <= y_start + y_width) {
          wldlcd_draw_block(
              x_start - (render_process - y_start) / y_vector * x_vector,
              render_process,
              x_start + (render_process - y_start) / x_vector * y_vector,
              render_process, color);

        } else if (render_process >= y_start + y_length) {
          wldlcd_draw_block(
              x_start - x_length +
                  (render_process - y_start - y_length) / x_vector * y_vector,
              render_process,
              x_start + x_width -
                  (render_process - y_start - y_width) / y_vector * x_vector,
              render_process, color);

        } else {
          wldlcd_draw_block(
              x_start - (render_process - y_start) / y_vector * x_vector,
              render_process,
              x_start + x_width -
                  (render_process - y_start - y_width) / y_vector * x_vector,
              render_process, color);
        }
      }
    } else {
      // ========================== Configure ================================
      for (render_process = x_start + x_width;
           render_process >= x_start - x_length; render_process--) {
        if (render_process >= x_start) {
          wldlcd_draw_block(
              render_process,
              y_start + y_width -
                  (x_start + x_width - render_process) / y_vector * x_vector,
              render_process,
              y_start + y_width +
                  (x_start + x_width - render_process) / x_vector * y_vector,
              color);

        } else if (render_process <= x_start - x_length + x_width) {
          wldlcd_draw_block(
              render_process,
              y_start + (x_start - render_process) / x_vector * y_vector,
              render_process,
              y_start + y_width + y_length -
                  (x_start - x_length + x_width - render_process) / y_vector *
                      x_vector,
              color);

        } else {
          wldlcd_draw_block(
              render_process,
              y_start + (x_start - render_process) / x_vector * y_vector,
              render_process,
              y_start + y_width +
                  (x_start + x_width - render_process) / x_vector * y_vector,
              color);
        }
      }
    }
  }
}
// ##########################
// ##########################
//
// draw a line in lcd
//
// ##########################
// ##########################
void wldlcd_draw_line_p2a(uint16_t x_start, uint16_t y_start, uint16_t length,
                          int16_t angle, uint32_t color, uint16_t width) {
  float x_vector = 0, y_vector = 0;
  angle = -angle;
  while (angle < 0)
    angle += 360;
  ;
  while (angle > 360)
    angle -= 360;
  ;
  if (angle % 90 <= 20 || angle % 90 >= 70) {
    wldlcd_draw_line_method_1(x_start, y_start, length, angle, color, width);
    return;
  }
  if (angle <= 90) {
    x_vector = wldtool_cos_lookuptable[angle];
    y_vector = wldtool_sin_lookuptable[angle];
    wldlcd_draw_line_method_2(x_start + width * y_vector / 2,
                              y_start - width * x_vector / 2, length, width,
                              angle, color);

  } else if (angle <= 180 & angle > 90) {
    x_vector = wldtool_cos_lookuptable[180 - angle];
    y_vector = wldtool_sin_lookuptable[180 - angle];
    wldlcd_draw_line_method_2(x_start - width * y_vector / 2,
                              y_start - width * x_vector / 2, length, width,
                              angle, color);

  } else if (angle <= 270 & angle > 180) {
    x_vector = wldtool_cos_lookuptable[angle - 180];
    y_vector = wldtool_sin_lookuptable[angle - 180];
    wldlcd_draw_line_method_2(
        x_start + width * y_vector / 2 - length * x_vector,
        y_start + width * x_vector / 2 - length * y_vector, length, width,
        angle - 180, color);

  } else {
    x_vector = wldtool_cos_lookuptable[360 - angle];
    y_vector = wldtool_sin_lookuptable[360 - angle];
    wldlcd_draw_line_method_2(
        x_start - width * y_vector / 2 + length * x_vector,
        y_start + width * x_vector / 2 - length * y_vector, length, width,
        angle - 180, color);
  }
}
// ##########################
// ##########################
// basic content render function
// but render backgroundcolor 2 single color
// only ascill character
// ##########################
// ##########################
void wldlcd_draw_string_minium(uint16_t x, uint16_t y, char *string,
                               uint32_t color, uint16_t backgroundcolor) {
  uint8_t *buffer_point = wldlcd_buffer;
  uint8_t character_counter = 0;
  while (*string > 31 & *string < 127) {
    uint8_t row = 0;
    uint8_t column = 0;
    unsigned char tmp = 0;
    for (row = 0; row < 16; row++) {
      tmp = wldutil_ascill[*string - 32][row];
      for (column = 0; column < 8; column++) {
        if (tmp & 0x80) {
          *buffer_point = color >> 8;
          buffer_point++;
          *buffer_point = color;
          buffer_point++;
        } else {
          *buffer_point = backgroundcolor >> 8;
          buffer_point++;
          *buffer_point = backgroundcolor;
          buffer_point++;
        }
        tmp = tmp << 1;
      }
    }
    buffer_point = wldlcd_buffer;
    lcd_ili9341_drawimage(x + character_counter * 8, y, 8, 16, buffer_point);
    character_counter++;
    string++;
  }
}
// ##########################
// ##########################
//
// basic character render function
// only ascill character
// ##########################
// ##########################
void wldlcd_draw_single_character(uint16_t x, uint16_t y, char c,
                                  uint32_t color, uint32_t backgroundcolor,
                                  uint8_t fontsize) {
  uint8_t *buffer_point = wldlcd_buffer;
  uint8_t row = 0, column = 0, fontsize_row = fontsize,
          fontsize_column = fontsize;
  unsigned char tmp = 0;
  for (row = 0; row < 16; row++) {
    tmp = wldutil_ascill[c - 32][row];
    for (column = 0; column < 8; column++) {
      if (tmp & 0x80) {
        tmp = tmp << 1;
        wldlcd_draw_block(x + column * fontsize, y + row * fontsize,
                          x + column * fontsize + fontsize - 1,
                          y + row * fontsize + fontsize - 1, color);
      } else {
        tmp = tmp << 1;
        if (backgroundcolor == 0x80000000)
          continue;
        wldlcd_draw_block(x + column * fontsize, y + row * fontsize,
                          x + column * fontsize + fontsize - 1,
                          y + row * fontsize + fontsize - 1, backgroundcolor);
      }
    }
  }
}
// ##########################
// ##########################
// content render function
// only ascill character
//
// ##########################
// ##########################
void wldlcd_draw_string(uint16_t x, uint16_t y, char *string, uint32_t color,
                        uint32_t backgroundcolor, uint8_t fontsize) {
  uint8_t character_counter = 0;
  while (*string > 31 & *string < 127) {
    character_counter++;
    wldlcd_draw_single_character(x + 8 * fontsize * character_counter, y,
                                 *string, color, backgroundcolor, fontsize);
    string++;
  }
}
unsigned char wldutil_ascill[95][16] = {
    {0x00, 0x00, 0x00, 0x00, 0x00, 0x00, 0x00, 0x00, 0x00, 0x00, 0x00, 0x00,
     0x00, 0x00, 0x00, 0x00},
    {0x00, 0x00, 0x00, 0x10, 0x10, 0x10, 0x10, 0x10, 0x10, 0x10, 0x00, 0x00,
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     0x00, 0x00, 0x00, 0x00}};
